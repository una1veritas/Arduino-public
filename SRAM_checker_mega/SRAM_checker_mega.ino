#include <LibPrintf.h>

/*
 * 12 ns -- 1/83.3M
 * 55 ns -- 1/18.2M
 * 70 ns -- 1/14.3M
 */
struct SRAM4mb {
  const int _WE = 41; // WR
  const int _OE = 40; // RD
  const int _CE = 39; //ALE

  SRAM4mb() {
    // address bus output
    DDRA = 0xff;
    PORTA = 0x00; // A0 -- A7
    DDRC = 0xff;
    PORTC = 0x00; // A7 -- A15
    DDRK = 0x01;
    PORTK = 0x00; // A16
    // data bus initially input
    DDRL = 0x00;
    PORTL = 0xff; // WPULLUP
    pinMode(_WE, OUTPUT);
    pinMode(_OE, OUTPUT);
    pinMode(_CE, OUTPUT);
  }

  uint8_t read(const uint32_t addr32) {
    const uint8_t * addr = (uint8_t *) & addr32;
    uint8_t val;
    PORTL = 0xff; // WPULLUP
    DDRL = 0x00; // input
    digitalWrite(_CE, LOW);
    PORTA = *addr++;
    PORTC = *addr++;
    PORTK = (PORTK & 0xfe) | (*addr & 0x01);
    digitalWrite(_OE, LOW);
    //asm("nop");
    val = PINL;
    digitalWrite(_OE, HIGH);
    digitalWrite(_CE, HIGH);
    return val;
  }

  uint8_t write(const uint32_t addr32, const uint8_t val) {
    const uint8_t * addr = (uint8_t *) & addr32;
    DDRL = 0xff; // output
    //PORTL = 0x00; // NO WPULLUP
    digitalWrite(_CE, LOW);
    PORTL = val;
    PORTA = *addr++;
    PORTC = *addr++;
    PORTK = (PORTK & 0xfe) | (*addr & 0x01);
    digitalWrite(_WE, LOW);
    //asm("nop");
    digitalWrite(_WE, HIGH);
    digitalWrite(_CE, HIGH);
  }
  
};

SRAM4mb sram; 
uint8_t rndtbl0[256] = {
  0xdd, 0x9a, 0xe1, 0xa7, 0xbd, 0x2c, 0x95, 0x07, 0x6d, 0x3b, 0x3a, 0x40, 0xaa, 0x43, 0xf6, 0x7d, 
  0x90, 0x02, 0x84, 0xf8, 0x5d, 0x81, 0x08, 0x94, 0xde, 0x92, 0xc2, 0x74, 0x2e, 0x96, 0xe5, 0x01, 
  0x79, 0x54, 0xa3, 0xd2, 0x5b, 0x76, 0x1f, 0xce, 0x69, 0x7a, 0x7b, 0xf5, 0x9e, 0x83, 0x0a, 0x4d, 
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  0x24, 0xea, 0x1a, 0x85, 0xb7, 0xb1, 0x45, 0xc4, 0x72, 0xbf, 0x50, 0xef, 0xff, 0x5a, 0x39, 0x41, 
};
uint8_t rndtbl1[256] = {
  0xfb, 0x58, 0xce, 0x21, 0x25, 0xa1, 0xd0, 0x7d, 0xd9, 0x5b, 0x3a, 0x9e, 0x31, 0x82, 0x90, 0x0b, 
  0x9a, 0x19, 0x6f, 0x26, 0x56, 0x85, 0x11, 0x2a, 0xc6, 0x3f, 0x6c, 0xbe, 0x01, 0x77, 0xe4, 0x95, 
  0x7f, 0xd2, 0x10, 0x2c, 0x72, 0xde, 0x91, 0xf4, 0x29, 0xf8, 0xd6, 0x41, 0x20, 0x09, 0x8d, 0x59, 
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  0x70, 0x7b, 0xb3, 0x39, 0x78, 0xb5, 0x0f, 0x42, 0x3b, 0x2f, 0x7e, 0x4b, 0xef, 0x49, 0xe9, 0x2b, 
};
uint8_t rbuff[256];

void setup () {
  uint32_t addr32 ;
  uint32_t succs = 0, fails = 0;
	const uint32_t RAM_UB = 0x20000; //(1UL<<17);

  uint32_t addr;
  uint8_t rndval;
  bool addr_randomize = true;

  Serial.begin (57600);
  while (!Serial);
	Serial.println("using rndtbl0:");
  for(int i = 0; i < 256; ++i) {
    printf("%02x ", rndtbl0[i]);
    if ( (i&0x0f) == 0x0f) 
    Serial.println();
  }

  Serial.println();
  Serial.println("Checking...");
  if (addr_randomize) {
    Serial.println("using rndtbl1 for address low 8 bit");
  }
	for(addr32 = 0; addr32 < RAM_UB; addr32 += 256) {
		if ( (addr32 & 0x1fff) == 0 ) {
			printf("%06lx\r\n", addr32);
			//Serial.print(addr32, HEX);
		}
    for(uint32_t i = 0; i < 256; ++i) {
      rndval = rndtbl0[addr % 251];
      if (addr_randomize) {
        addr = addr32 + rndtbl1[i];
      } else {
        addr = addr32 + i;
      }
      rbuff[i] = sram.read(addr); 
      sram.write(addr, rbuff[i]^rndval); 
    }
    for(uint32_t i = 0; i < 256; ++i) {
      rndval = rndtbl0[addr % 251];
      if (addr_randomize) {
        addr = addr32 + rndtbl1[i];
      } else {
        addr = addr32 + i;
      }
      uint8_t data = sram.read(addr); 
      sram.write(addr, rbuff[i]);

      if ( data^rndval == rbuff[i] ) {
        succs++;
      } else {
        fails++;
        printf("%06lx: %02x %02x\r\n", addr32+i, data^rndval, rbuff[i]);
      }
    }
  }

  printf("Finisdhed read/write checks from address 0 to %06lx.\r\n", addr32 - 1);
  Serial.print("succs = "); Serial.println(succs);
  Serial.print("fails = "); Serial.println(fails);
}

void loop () {

}
